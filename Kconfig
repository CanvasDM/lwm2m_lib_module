## Kconfig
```kconfig
#
# Copyright (c) 2022 Laird Connectivity
#
# SPDX-License-Identifier: Apache-2.0
#

menuconfig LCZ_LWM2M_LIBRARY
    bool "Laird Connectivity LwM2M Library Component"

if LCZ_LWM2M_LIBRARY
rsource "lib_lwm2m/Kconfig"
endif # LCZ_LWM2M_LIBRARY
```

## lib_lwm2m/Kconfig
```kconfig
#
# Copyright (c) 2022 Laird Connectivity
#
# SPDX-License-Identifier: Apache-2.0
#

menuconfig LCZ_LWM2M_LIB
    bool "Laird Connectivity custom LwM2M library"

if LCZ_LWM2M_LIB
rsource "source/Kconfig"
endif # LCZ_LWM2M_LIB
```
